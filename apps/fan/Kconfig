## apps/fan/Kconfig
```kconfig
config APP_FAN
    bool "fan"
    depends on LIB_SEL4 && HAVE_LIBC && LIB_SOS && LIB_PLATSUPPORT
    default y
    select HAVE_SEL4_APPS
    help
        Building Automation Control Application
```

## apps/proxy/Kconfig
```kconfig
menuconfig APP_PROXY
    bool "Updated Proxy Applications"
    depends on LIB_SEL4 && HAVE_LIBC && LIB_SOS
    default y
    select HAVE_SEL4_APPS
    help
        Network proxy.

config APP_PROXY_MAX_NUM_CLIENTS
    int "Maximum number of clients a proxy can serve"
    default 16
    help
        Affects how much static memory and worker threads are preallocated.

config APP_PROXY_TEMP_CONTROL
    bool "PROXY: Temperature Controller"
    depends on APP_PROXY
    default n

config APP_PROXY_SENSOR
    bool "PROXY Sensor"
    depends on APP_PROXY
    default n

config APP_PROXY_FAN
    bool "PROXY: Fan"
    depends on APP_PROXY
    default n
```

## apps/proxy1/Kconfig
```kconfig
menuconfig APP_PROXY1
    bool "Proxy Applications"
    depends on LIB_SEL4 && HAVE_LIBC && LIB_SOS
    default y
    select HAVE_SEL4_APPS
    help
        Network proxy.

config APP_PROXY_TEMP_CONTROL
    bool "Temperature Controller"
    depends on APP_PROXY1
    default n

config APP_PROXY_SENSOR
    bool "Sensor"
    depends on APP_PROXY1
    default n

config APP_PROXY_FAN
    bool "Fan"
    depends on APP_PROXY1
    default n
```

## apps/sensor/Kconfig
```kconfig
config APP_SENSOR
    bool "sensor"
    depends on LIB_SEL4 && HAVE_LIBC && LIB_SOS
    default y
    select HAVE_SEL4_APPS
    help
        A demo app
```

## apps/temp_control/Kconfig
```kconfig
config APP_TEMP_CONTROL
    bool "temp_control"
    depends on LIB_SEL4 && HAVE_LIBC && LIB_SOS
    default y
    select HAVE_SEL4_APPS
    help
        Building Automation Control Application
```

## apps/web/Kconfig
```kconfig
config APP_WEB
    bool "web"
    depends on LIB_SEL4 && HAVE_LIBC && LIB_SOS
    default y
    select HAVE_SEL4_APPS
    help
        Building Management Interface Application
```
